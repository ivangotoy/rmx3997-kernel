## drivers/net/amneziawg/Kconfig
```kconfig
# SPDX-License-Identifier: GPL-2.0
config AMNEZIAWG
	tristate "AmneziaWG secure network tunnel"
	depends on NET && INET
	depends on IPV6 || !IPV6
	select NET_UDP_TUNNEL
	select DST_CACHE
	select CRYPTO
	select CRYPTO_LIB_CURVE25519
	select CRYPTO_LIB_CHACHA20POLY1305
	select CRYPTO_CHACHA20_X86_64 if X86 && 64BIT
	select CRYPTO_POLY1305_X86_64 if X86 && 64BIT
	select CRYPTO_BLAKE2S_X86 if X86 && 64BIT
	select CRYPTO_CURVE25519_X86 if X86 && 64BIT
	select ARM_CRYPTO if ARM
	select ARM64_CRYPTO if ARM64
	select CRYPTO_CHACHA20_NEON if ARM || (ARM64 && KERNEL_MODE_NEON)
	select CRYPTO_POLY1305_NEON if ARM64 && KERNEL_MODE_NEON
	select CRYPTO_POLY1305_ARM if ARM
	select CRYPTO_BLAKE2S_ARM if ARM
	select CRYPTO_CURVE25519_NEON if ARM && KERNEL_MODE_NEON
	select CRYPTO_CHACHA_MIPS if CPU_MIPS32_R2
	select CRYPTO_POLY1305_MIPS if MIPS
	help
	  AmneziaWG is a fork of WireGuard that adds traffic obfuscation
	  (junk packets, randomized message headers and padding) against
	  deep packet inspection. Interfaces are created with the
	  "amneziawg" rtnl link kind and configured over the "amneziawg"
	  generic netlink family, for example with awg(8) and awg-quick(8)
	  from amneziawg-tools. It can be built next to WireGuard.

	  It's safe to say Y or M here, as the driver is very lightweight and
	  is only in use when an administrator chooses to add an interface.

config AMNEZIAWG_DEBUG
	bool "Debugging checks and verbose messages"
	depends on AMNEZIAWG
	help
	  This will write log messages for handshake and other events
	  that occur for an AmneziaWG interface. It will also perform some
	  extra validation checks and unit tests at various points. This is
	  only useful for debugging.

	  Say N here unless you know what you're doing.
```
